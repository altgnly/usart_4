	LIST P=16F877A
	#INCLUDE <P16F877A.INC>
	__CONFIG H'3F31'
	SAYICI1 EQU 0X20
	SAYICI2 EQU 0X21
	ORG 0X000 
	GOTO ANA_METOT

ANA_METOT
	BANKSEL TRISD
	MOVLW 0XFF
	MOVWF TRISC
	CLRF TRISD
	BANKSEL PORTD
	MOVLW 0XFF
	MOVWF PORTC
	CLRF PORTD

	BANKSEL SPBRG
	MOVLW D'25'
	MOVWF SPBRG
	BANKSEL SPBRG

	BANKSEL TXSTA
	MOVLW B'00000100'
	MOVWF TXSTA
	BANKSEL TXSTA

	BANKSEL RCSTA
	MOVLW B'10010000'
	MOVWF RCSTA
	BANKSEL RCSTA

KONTROL
	BTFSC PIR1,RCIF
	GOTO DEGER_YAZ
	GOTO KONTROL

DEGER_YAZ
	MOVF RCREG,W
	MOVWF PORTD
	CALL GECIKME
	GOTO KONTROL

GECIKME
	MOVLW D'60'
	MOVWF SAYICI1

TEKRAR1
	MOVLW D'130'
	MOVWF SAYICI2

TEKRAR2
	DECFSZ SAYICI2,F
	GOTO TEKRAR2
	DECFSZ SAYICI1,F
	GOTO TEKRAR1
	RETURN

END